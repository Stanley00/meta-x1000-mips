## conf/machine/halley2.conf
```bitbake
#@TYPE: Machine
#@NAME: HALLEY2
#@SOC: Ingenic X1000 MIPS
#@DESCRIPTION: MIPS X1000 Halley2
#@MAINTAINER: Leon Anavi <leon@anavi.org>

require conf/machine/include/tune-mips32r2.inc
IMAGE_CLASSES += "image_types_halley2"

DEFAULTTUNE = "mips32r2el"
MACHINE_FEATURES = "serial"
SERIAL_CONSOLES = "115200;ttyS2 115200;ttyS4"

EXTRA_IMAGEDEPENDS += "u-boot-halley2"
UBOOT_MACHINE = "halley2_v10_uImage_sfc_nor"

KERNEL_IMAGETYPE = "uImage"

PREFERRED_PROVIDER_virtual/kernel ?= "linux-halley2"
PREFERRED_VERSION_linux-halley2 ?= "3.10%"
PREFERRED_VERSION_u-boot="v2013.07"

MACHINE_ESSENTIAL_EXTRA_RDEPENDS = "kernel kernel-modules"

SDCARD_ROOTFS ?= "${DEPLOY_DIR_IMAGE}/${IMAGE_NAME}.rootfs.ext4"
IMAGE_FSTYPES ?= " ext4 "
```
